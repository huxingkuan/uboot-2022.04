// SPDX-License-Identifier: (GPL-2.0 OR MIT)
//
// Copyright (C) 2016 Freescale Semiconductor, Inc.

/dts-v1/;

#include "imx6ull.dtsi"
#include "imx6ul-100ask.dtsi"
#include "imx6ul-100ask-u-boot.dtsi"

/ {
	model = "i.MX6 ULL 100ASK EMMC Board";
	compatible = "fsl,imx6ull-100ask", "fsl,imx6ull";
};

&clks {
	assigned-clocks = <&clks IMX6UL_CLK_PLL3_PFD2>;
	assigned-clock-rates = <320000000>;
};
